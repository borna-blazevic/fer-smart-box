## components/wifi/Kconfig.projbuild
```kconfig
menu "WiFi Connection Configuration"

    config WIFI_SSID
        string "WiFi SSID"
        default "IT HURTS WHEN IP"
        help
            SSID (network name) for the system to connect to.
    
    config EAP_SECURITY_MODE
        bool "EAP Security mode"
        default "1"
        help
            Security mode of the AP, 1=EAP, 0=WPA

    config WIFI_USERNAME
        string "WiFi username"
        default "username"
        help
            WiFi username (EAP) for the system to use.

    config WIFI_PASSWORD
        string "WiFi password"
        default "bobosmrade"
        help
            WiFi password (WPA or WPA2) for the system to use.

    config LIMIT_NUMBER_OF_RETRIES
        bool "Limit retry"
        default false
        help
            Set the Limit number of entries to avoid station reconnecting to the AP unlimited when the AP is really inexistent.

    config MAXIMUM_RETRY
        int "Maximum retry"
        default 5
        help
            Set the Maximum retry to avoid station reconnecting to the AP unlimited when the AP is really inexistent.
endmenu
```
